## CMakeLists.txt
```
#
# Copyright (c) 2018 Nordic Semiconductor
#
# SPDX-License-Identifier: LicenseRef-Nordic-5-Clause
#
cmake_minimum_required(VERSION 3.20.0)

find_package(Zephyr REQUIRED HINTS $ENV{ZEPHYR_BASE})
project(ilockit_pro)

# NORDIC SDK APP START
target_sources(app PRIVATE src/main.c)

# I LOCK IT Bibliotheken
target_include_directories(app PRIVATE src)

target_sources(app PRIVATE ../../libs/bluetooth/services/ili/ili.c)
target_include_directories(app PRIVATE ../../libs/bluetooth/services/ili)

target_include_directories(app PRIVATE ../../libs/parser)
target_sources(app PRIVATE ../../libs/parser/ili_parser.c)

target_include_directories(app PRIVATE ../../libs/aes)
target_sources(app PRIVATE ../../libs/aes/aes.c)

target_include_directories(app PRIVATE ../../libs/button)
target_sources(app PRIVATE ../../libs/button/ili_button.c)

target_include_directories(app PRIVATE ../../libs/motorcontroller)
target_sources(app PRIVATE ../../libs/motorcontroller/ili_motorcontroller.c)

target_include_directories(app PRIVATE ../../libs/accelerometer)
target_sources(app PRIVATE ../../libs/accelerometer/ili_accelerometer.c)

target_include_directories(app PRIVATE ../../libs/battery)
target_sources(app PRIVATE ../../libs/battery/ili_battery.c)

target_include_directories(app PRIVATE ../../libs/uicr)
target_sources(app PRIVATE ../../libs/uicr/ili_uicr.c)

target_include_directories(app PRIVATE ../../libs/ble)
target_sources(app PRIVATE ../../libs/ble/ili_client.c)

target_include_directories(app PRIVATE ../../libs/piezo)
target_sources(app PRIVATE ../../libs/piezo/ili_piezo.c)

target_include_directories(app PRIVATE ../../libs/led)
target_sources(app PRIVATE ../../libs/led/ili_led.c)

target_include_directories(app PRIVATE ../../libs/can)
target_sources(app PRIVATE ../../libs/can/ili_can.c)
target_sources(app PRIVATE ../../libs/can/ili_can_matrix.c)
target_sources(app PRIVATE ../../libs/can/ili_can_auth.c)
target_sources(app PRIVATE ../../libs/can/ili_can_bond.c)


# NORDIC SDK APP END
```

## sysbuild.conf
```
# Sysbuild configuration file.

# MCUboot für die Applikation aktivieren.
SB_CONFIG_BOOTLOADER_MCUBOOT=y


# STEP 2.2 - Disable the Partition Manager
#SB_CONFIG_PARTITION_MANAGER=y

# Paritionsmanager für Flash-Konfiguration
#SB_CONFIG_PARTITION_MANAGER=y
SB_CONFIG_BOOT_SIGNATURE_TYPE_ECDSA_P256=y
SB_CONFIG_BOOT_SIGNATURE_KEY_FILE="\${APPLICATION_CONFIG_DIR}/../../../mcuboot-private.pem"
```

## prj.conf
```kconfig
#
# Copyright (c) 2018 Nordic Semiconductor
#
# SPDX-License-Identifier: LicenseRef-Nordic-5-Clause
#
CONFIG_NCS_SAMPLES_DEFAULTS=y
# Zum Schützen der Firmware muss das auf y gesetzt werden
CONFIG_FPROTECT=n

CONFIG_BT=y
CONFIG_BT_PERIPHERAL=y
# Extended Advertising API (bt_le_ext_adv_*) wird in main.c genutzt
# TEST: fuer ADV_TEST_LEGACY=1 (main.c) wird nur Legacy-Advertising gebraucht.
# Zum Zurueckschalten auf Extended Advertising wieder auf y setzen.
CONFIG_BT_EXT_ADV=n

CONFIG_DK_LIBRARY=n

# Enable Logging and RTT
CONFIG_LOG=y
CONFIG_LOG_MODE_MINIMAL=y
CONFIG_USE_SEGGER_RTT=y
CONFIG_CONSOLE=y
CONFIG_RTT_CONSOLE=y
CONFIG_UART_CONSOLE=n
CONFIG_SEGGER_RTT_BUFFER_SIZE_UP=4096
CONFIG_LOG_MODE_DEFERRED=n

# Enable GPIO
CONFIG_GPIO=y

# UART aktivieren (UARTE00 -> GPS-Modul, TX=P2.08, RX=P2.00)
# Der Konsolen-Output laeuft weiterhin ueber RTT (CONFIG_UART_CONSOLE=n)
CONFIG_SERIAL=y
CONFIG_UART_ASYNC_API=y

# CAN-Controller MCP2518FD an SPIM00.
# ACHTUNG: SPIM00 und UARTE00 sind derselbe Serial-Block (0x0004A000) -
# es kann immer nur eines von beidem laufen. Passend dazu muss im Board-DTS
# spi00 "okay" und uart00 "disabled" stehen. Zum Zurueckschalten auf GPS
# diesen Block auskommentieren und im DTS umstellen.
# CAN_MCP251XFD ist "default y" und zieht CONFIG_SPI + CONFIG_CRC selbst nach.
#
# Der Controller wird von libs/can nur initialisiert und sofort in den Standby
# gelegt (Transceiver aus, Controller im Sleep) - can_start() laeuft nicht.
# Erst ili_can_listen_start() nimmt ihn in Betrieb.
CONFIG_CAN=y
CONFIG_CAN_LOG_LEVEL_WRN=y

# CAN-FD (ISO 11898-1), Datenphase 2 Mbit/s - die Gegenstelle spricht FD.
# Der Treiber schaltet damit in den MIXED-Mode und empfaengt FD- UND
# Classic-Frames; Bitraten und Sample-Points stehen im Board-DTS.
#
# Nebenwirkung: CAN_MAX_DLEN wird global 8 -> 64. Damit waechst
# struct can_frame von 16 auf 72 Byte, und die FIFOs im 2-KB-RAM des
# MCP2518FD werden groesser. Mit den Defaults (TX-Queue 8, RX-FIFO 16)
# sind 1792 von 2048 Byte belegt - passt. CONFIG_CAN_MCP251XFD_RX_FIFO_ITEMS
# laesst sich aber nur noch bis ca. 19 erhoehen, darueber schlaegt das
# BUILD_ASSERT "Cannot fit FIFOs into RAM" in can_mcp251xfd.h zu.
CONFIG_CAN_FD_MODE=y

# Der Interrupt-Thread des mcp251xfd legt einen kompletten struct can_frame
# auf seinen Stack (can_mcp251xfd.c, mcp251xfd_rx_fifo_handler). Mit CAN-FD
# sind das 72 statt 16 Byte - der Default von 768 wird knapp.
CONFIG_CAN_MCP251XFD_INT_THREAD_STACK_SIZE=1024

# Power Management aktivieren
CONFIG_PM_DEVICE=y
CONFIG_PM_DEVICE_RUNTIME=y
CONFIG_TICKLESS_KERNEL=y

# Enable I2C driver
CONFIG_I2C=y
CONFIG_I2C_CALLBACK=y

# Enable nordic security backend and PSA APIs
#CONFIG_NRF_SECURITY=y
CONFIG_MBEDTLS_PSA_CRYPTO_C=y
CONFIG_PSA_WANT_ALG_SHA_256=y
CONFIG_PSA_WANT_GENERATE_RANDOM=y

# CRC Bibliothek hinzufügen
CONFIG_CRC=y

# Dynamisches Festlegen des Advertisment Namens
CONFIG_BT_DEVICE_NAME_DYNAMIC=y
# TEST: fester Default-Name (wird in main.c zusaetzlich per bt_set_name() gesetzt)
CONFIG_BT_DEVICE_NAME="ILI-PRO-TEST"
# Länge muss 25 betragen, wenn der Wert kleiner gewählt wird, startet das Advertisment nicht
CONFIG_BT_DEVICE_NAME_MAX=25

# Anzahl maximaler Verbindungen
CONFIG_BT_MAX_CONN=4

# Verbindungsparameter zur App
CONFIG_BT_PERIPHERAL_PREF_MIN_INT=20
CONFIG_BT_PERIPHERAL_PREF_MAX_INT=60
CONFIG_BT_PERIPHERAL_PREF_LATENCY=0
CONFIG_BT_PERIPHERAL_PREF_TIMEOUT=300
CONFIG_BT_GAP_AUTO_UPDATE_CONN_PARAMS=y

# Anzahl maximaler Verbindungen mit Smartphone
CONFIG_BT_CTLR_SDC_PERIPHERAL_COUNT=3

# PWM aktivieren
CONFIG_PWM=y
CONFIG_NRFX_PWM=y

# Reboot Library aktivieren
CONFIG_REBOOT=y

# ZMS/Flash aktivieren
CONFIG_FLASH=y
CONFIG_NVS=n
CONFIG_ZMS=y
CONFIG_FLASH_PAGE_LAYOUT=y
CONFIG_ZMS_LOG_LEVEL_DBG=n
CONFIG_FLASH_MAP=y
CONFIG_SETTINGS=y
CONFIG_SETTINGS_ZMS=y

# RAM Memory retention aktivieren
CONFIG_RETENTION=y
CONFIG_RETAINED_MEM=y

# Abfrage der RSSI-Werte aktivieren
CONFIG_BT_CTLR_CONN_RSSI=y

# Multithreading aktivieren
CONFIG_MULTITHREADING=y

# Watchdog hinzufügen
CONFIG_WATCHDOG=y
CONFIG_WDT_DISABLE_AT_BOOT=n

# SAADC Wandler und PPI für die Batteriemessung, Timer für LED und Batteriemessung
CONFIG_NRFX_SAADC=y
CONFIG_NRFX_GPPI=y
CONFIG_NRFX_TIMER=y

# Handsender Konfiguration
CONFIG_BT_CENTRAL=y
CONFIG_BT_SCAN=y
CONFIG_BT_SMP=y
CONFIG_BT_GATT_CLIENT=y
CONFIG_BT_GATT_DM=y
CONFIG_HEAP_MEM_POOL_SIZE=4096
CONFIG_BT_SETTINGS=y
CONFIG_HW_STACK_PROTECTION=y
CONFIG_BT_SCAN_WITH_IDENTITY=y
CONFIG_BT_FILTER_ACCEPT_LIST=y
CONFIG_BT_MAX_PAIRED=5
CONFIG_BT_SMP_SC_PAIR_ONLY=n

# Increase stack size for the main thread and System Workqueue
CONFIG_SYSTEM_WORKQUEUE_STACK_SIZE=4096
CONFIG_MAIN_STACK_SIZE=4096

#https://devzone.nordicsemi.com/guides/nrf-connect-sdk-guides/b/software/posts/building-a-ble-application-on-ncs-sdk---contrasting-to-softdevice-based-ble-applications---part-2-central-role#mcetoc_1f50ptl3g2

# FOTA update Service
#CONFIG_SECURE_BOOT=y
CONFIG_NCS_SAMPLE_MCUMGR_BT_OTA_DFU=y
CONFIG_MCUMGR_MGMT_NOTIFICATION_HOOKS=y
CONFIG_MCUMGR_GRP_IMG_UPLOAD_CHECK_HOOK=y
CONFIG_MCUMGR_GRP_OS_RESET_HOOK=y
CONFIG_MCUMGR_GRP_IMG_STATUS_HOOKS=y

# Basic SMP Befehle zum Löschen der Settings verbieten
CONFIG_MCUMGR_GRP_ZBASIC=n
CONFIG_MCUMGR_GRP_ZBASIC_STORAGE_ERASE=n

#https://www.youtube.com/watch?v=fCU8x-pmtqU

CONFIG_THREAD_ANALYZER=n
CONFIG_THREAD_ANALYZER_USE_LOG=n
CONFIG_THREAD_ANALYZER_AUTO=n

# Use Zephyr BLE Stack instead of Nordic
# Saves ~60kB of ROM
#CONFIG_BT_LL_SOFTDEVICE=n

#CONFIG_PWM_NRF_SW=y
#CONFIG_BT_TINYCRYPT_ECC=y

# Apple Find-My
#CONFIG_FMNA=y
#CONFIG_FMNA_NORDIC_PRODUCT_PLAN=n
#CONFIG_FMNA_LOG_LEVEL_DBG=n

#CONFIG_FMNA_CAPABILITY_PLAY_SOUND_ENABLED=y
#CONFIG_FMNA_CAPABILITY_DETECT_MOTION_ENABLED=y
#CONFIG_FMNA_CAPABILITY_BLE_SN_LOOKUP_ENABLED=y
#CONFIG_FMNA_CAPABILITY_NFC_SN_LOOKUP_ENABLED=n
#CONFIG_FMNA_CAPABILITY_FW_UPDATE_ENABLED=n
#CONFIG_FMNA_PAIRING_MODE_AUTO_ENTER=n
#CONFIG_FMNA_MANUFACTURER_NAME="haveltec GmbH"
#CONFIG_FMNA_SERVICE_HIDDEN_MODE=y
#CONFIG_FMNA_QUALIFICATION=y
# Bluetooth dependent configuration required by FMN
#CONFIG_BT_RX_STACK_SIZE=3072

# Zwei Advertising-Sets und zwei BLE IDs
#CONFIG_BT_ID_MAX=2
#CONFIG_BT_EXT_ADV_MAX_ADV_SET=2

# PSA Secure Storage
CONFIG_ENTROPY_GENERATOR=y
CONFIG_PSA_WANT_KEY_TYPE_AES=y
CONFIG_PSA_WANT_ALG_CTR=y
# AES-128-ECB fuer die Bosch-eLock-Authentifizierung (Spezifikation 12.2.3).
# Nicht ueber libs/aes machbar: tiny-AES ist dort projektweit auf AES-256/CBC
# konfiguriert, ECB ist gar nicht einkompiliert.
CONFIG_PSA_WANT_ALG_ECB_NO_PADDING=y
# Bosch-eLock-Bonding (Spezifikation Kapitel 13): X25519-Schluesselaustausch,
# BondKey per HKDF-SHA256, Bond-Check und sichere Kommandos per AES-CMAC.
CONFIG_PSA_WANT_ALG_ECDH=y
CONFIG_PSA_WANT_ECC_MONTGOMERY_255=y
CONFIG_PSA_WANT_KEY_TYPE_ECC_KEY_PAIR_GENERATE=y
CONFIG_PSA_WANT_KEY_TYPE_ECC_KEY_PAIR_IMPORT=y
CONFIG_PSA_WANT_KEY_TYPE_ECC_KEY_PAIR_EXPORT=y
CONFIG_PSA_WANT_ALG_HKDF=y
CONFIG_PSA_WANT_ALG_HMAC=y
CONFIG_PSA_WANT_ALG_CMAC=y

CONFIG_MBEDTLS=y
CONFIG_MBEDTLS_PSA_CRYPTO_C=y
CONFIG_MBEDTLS_ENABLE_HEAP=y
CONFIG_MBEDTLS_HEAP_SIZE=1024

CONFIG_SECURE_STORAGE=y
#CONFIG_SECURE_STORAGE_ITS_STORE_IMPLEMENTATION_SETTINGS=y

CONFIG_ASSERT=y
CONFIG_DEBUG_OPTIMIZATIONS=y
```

## prj_minimal.conf
```kconfig
# BEGIN Configurations from basic/minimal

#
# Copyright (c) 2018 Nordic Semiconductor
#
# SPDX-License-Identifier: LicenseRef-Nordic-5-Clause
#


#https://devzone.nordicsemi.com/f/nordic-q-a/109194/reducing-rom-size-for-the-nrf52833/477386

CONFIG_NCS_SAMPLES_DEFAULTS=n

CONFIG_BT=y
CONFIG_BT_PERIPHERAL=y

CONFIG_DK_LIBRARY=n

# Enable RTT
CONFIG_USE_SEGGER_RTT=n
CONFIG_RTT_CONSOLE=n
CONFIG_LOG_BUFFER_SIZE=4096
CONFIG_LOG_BACKEND_SHOW_COLOR=n
CONFIG_LOG_BACKEND_FORMAT_TIMESTAMP=y
CONFIG_SEGGER_RTT_BUFFER_SIZE_UP=4096

# Enable GPIO
CONFIG_GPIO=y

# Enable UART driver
CONFIG_SERIAL=y
CONFIG_UART_ASYNC_API=y

# Power Management aktivieren
CONFIG_PM_DEVICE=y
CONFIG_PM_DEVICE_RUNTIME=y

# Interrupts
CONFIG_DYNAMIC_INTERRUPTS=n
CONFIG_IRQ_OFFLOAD=n

# Memory protection
CONFIG_THREAD_STACK_INFO=n
CONFIG_THREAD_CUSTOM_DATA=n
CONFIG_FPU=n

# Boot
CONFIG_BOOT_BANNER=n
CONFIG_BOOT_DELAY=0
# USB related configs
CONFIG_USB_DEVICE_STACK=n
CONFIG_USB_DEVICE_PRODUCT="ILOCKIT_PRO"
CONFIG_USB_DEVICE_PID=0x9876
CONFIG_USB_DRIVER_LOG_LEVEL_ERR=n
CONFIG_USB_DEVICE_LOOPBACK=n
CONFIG_USB_DEVICE_LOG_LEVEL_ERR=n
CONFIG_USB_DEVICE_INITIALIZE_AT_BOOT=n

# Enable I2C driver
CONFIG_I2C=y
CONFIG_I2C_CALLBACK=y

# Enable console
CONFIG_CONSOLE=n
CONFIG_UART_CONSOLE=n
CONFIG_STDOUT_CONSOLE=n
CONFIG_PRINTK=n
CONFIG_EARLY_CONSOLE=n

# Build
CONFIG_SIZE_OPTIMIZATIONS=y

# Enable logging
CONFIG_LOG=n
CONFIG_LOG_MODE_MINIMAL=y

CONFIG_SYSTEM_WORKQUEUE_STACK_SIZE=2048

CONFIG_LOG_MODE_DEFERRED=n

# ARM
CONFIG_ARM_MPU=n

# Enable nordic security backend and PSA APIs
CONFIG_NRF_SECURITY=y
CONFIG_MBEDTLS_PSA_CRYPTO_C=y

CONFIG_MBEDTLS_ENABLE_HEAP=n
CONFIG_MBEDTLS_HEAP_SIZE=8192

CONFIG_PSA_WANT_ALG_SHA_256=n

# CRC Bibliothek hinzufügen
CONFIG_CRC=y

# Dynamisches Festlegen des Advertisment Namens
CONFIG_BT_DEVICE_NAME_DYNAMIC=y
# Länge muss 25 betragen, wenn der Wert kleiner gewählt wird, startet das Advertisment nicht
CONFIG_BT_DEVICE_NAME_MAX=25

# Anzahl maximaler Verbindungen
CONFIG_BT_MAX_CONN=4

# Anzahl maximaler Verbindungen mit Smartphone
CONFIG_BT_CTLR_SDC_PERIPHERAL_COUNT=3

# PWM aktivieren
CONFIG_PWM=y

# Reboot Library aktivieren
CONFIG_REBOOT=y

# NVS/Flash aktivieren
CONFIG_FLASH=y
CONFIG_NVS=y
CONFIG_NVS_LOG_LEVEL_DBG=n
CONFIG_FLASH_PAGE_LAYOUT=y

CONFIG_FLASH_MAP=n
CONFIG_FLASH_MAP_CUSTOM=y

# RAM Memory retention aktivieren
CONFIG_RETENTION=y
CONFIG_RETAINED_MEM=y

# Abfrage der RSSI-Werte aktivieren
CONFIG_BT_CTLR_CONN_RSSI=y

# Multithreading aktivieren
CONFIG_MULTITHREADING=y

# Watchdog hinzufügen
CONFIG_WATCHDOG=y
CONFIG_WDT_DISABLE_AT_BOOT=n

# SAADC Wandler und PPI aktivieren
CONFIG_NRFX_SAADC=y
CONFIG_NRFX_PPI=y
CONFIG_NRFX_TIMER2=y

# Handsender Konfiguration
CONFIG_BT_CENTRAL=y
CONFIG_BT_SCAN=y
CONFIG_BT_SMP=y
CONFIG_BT_GATT_CLIENT=y
CONFIG_BT_GATT_DM=y
CONFIG_HEAP_MEM_POOL_SIZE=1024
CONFIG_SETTINGS=y
CONFIG_MAIN_STACK_SIZE=1536
CONFIG_BT_SCAN_WITH_IDENTITY=y
CONFIG_BT_FILTER_ACCEPT_LIST=y
CONFIG_BT_CTLR_PRIVACY=y

#https://devzone.nordicsemi.com/guides/nrf-connect-sdk-guides/b/software/posts/building-a-ble-application-on-ncs-sdk---contrasting-to-softdevice-based-ble-applications---part-2-central-role#mcetoc_1f50ptl3g2

# FOTA update Service
#CONFIG_NCS_SAMPLE_MCUMGR_BT_OTA_DFU=y
#https://www.youtube.com/watch?v=fCU8x-pmtqU


# Disable features not needed
CONFIG_TIMESLICING=n
#CONFIG_MINIMAL_LIBC_MALLOC=n

CONFIG_CBPRINTF_NANO=y
CONFIG_CBPRINTF_LIBC_SUBSTS=n
CONFIG_MINIMAL_LIBC=y
CONFIG_SIZE_OPTIMIZATIONS=y
CONFIG_TIMEOUT_64BIT=n
CONFIG_LOG=n
CONFIG_ASSERT=n # should be enabled while developing, disabled for production
CONFIG_CONSOLE=n # should be enabled while developing, disabled for production
CONFIG_USE_SEGGER_RTT=n # is this required for development? what does this really do?

# Disable Bluetooth features not needed
CONFIG_BT_DEBUG_NONE=y
CONFIG_BT_ASSERT=n
CONFIG_BT_DATA_LEN_UPDATE=n
CONFIG_BT_PHY_UPDATE=n
CONFIG_BT_GATT_CACHING=n
CONFIG_BT_GATT_SERVICE_CHANGED=n
CONFIG_BT_SETTINGS_CCC_LAZY_LOADING=y
CONFIG_BT_HCI_VS=y
CONFIG_BT_L2CAP_DYNAMIC_CHANNEL=n
CONFIG_BT_SETTINGS=n
CONFIG_BT_HCI=y
CONFIG_BT_EXT_ADV=n
CONFIG_BT_LL_SOFTDEVICE=y
CONFIG_BT_GATT_READ_MULTIPLE=n
CONFIG_BT_GATT_READ_MULT_VAR_LEN=n
CONFIG_BT_GAP_PERIPHERAL_PREF_PARAMS=n
CONFIG_BT_PHY_UPDATE=n
CONFIG_BT_CTLR_LE_PING=n
CONFIG_BT_CTLR_PRIVACY=n
CONFIG_BT_CTLR_PHY_2M=n

# Reduce Bluetooth buffers
CONFIG_BT_BUF_EVT_DISCARDABLE_COUNT=1
CONFIG_BT_BUF_EVT_DISCARDABLE_SIZE=43
CONFIG_BT_BUF_EVT_RX_COUNT=2

CONFIG_BT_CONN_TX_MAX=3
CONFIG_BT_L2CAP_TX_BUF_COUNT=2
CONFIG_BT_ATT_TX_COUNT=2
CONFIG_BT_CTLR_RX_BUFFERS=1
CONFIG_BT_BUF_ACL_TX_COUNT=3
CONFIG_BT_BUF_ACL_TX_SIZE=27

# NRFX PWM
CONFIG_NRFX_PWM1=y

# DFU Service
#ONFIG_SECURE_BOOT=y
#CONFIG_NCS_SAMPLE_MCUMGR_BT_OTA_DFU=y
#CONFIG_MCUMGR=y
#CONFIG_MCUMGR_TRANSPORT_BT=y
```

## src/commands.h
```c
#ifndef COMMANDS_H__
#define COMMANDS_H__
 
// Befehle f�r BLE-Kommunikation
////////// Befehlsliste /////////
#define REQUEST_DATA                        0x0001
#define SERIALNUMBER                        0x0003
#define CHALLENGE                           0x0004
#define CHALLENGE_GPS                       0x0044
#define AUTH_AUTHENTICATOR                  0x0005
#define AUTH_DATA                           0x0006
#define AUTH_ID                             0x0007
#define AUTH_ID_CONF                        0x0008
#define IV                                  0x0009
#define LTK                                 0x000A
#define LTK_CONF                            0x000B
#define LOCK_STATUS                         0x000E
#define LOCK_CONFIG                         0x000F
#define LOCK_CONFIG_PRO                     0x000D
#define CHALLENGE_RESP                      0x0010
#define LOCK_ACTION                         0x0011
#define CLICK_CODE                          0x0012
#define ALARM_SETTINGS                      0x0013 // Alter Befehl f�r die Alarmeinstellungen
#define SOUND_SETTINGS                      0x0014
#define AUTO_SETTINGS                       0x0015 // Alter Befehl f�r den Automatikmodus 
#define SHARE_CODE                          0x0016
#define LOCK_STATE                          0x0017
#define DEVICE_SETTINGS                     0x0018
#define ALARM_TIMES                         0x0019
#define DELETE_PEER                         0x001A
#define BATT_LEVEL                          0x001B
#define START_DFU                           0x001C
#define DND_MODE                            0x001D
#define KEYFOB_INFO                         0x001E
#define BOND_INFO                           0x001F
#define SMARTPHONE_INFO                     0x0020
#define CLICK_CODE_TEST                     0x0021
#define DFU_CHALLENGE                       0x0022
#define GPS_UUID                            0x0023
#define GPS_SIGNAL                          0x0024
#define AUTO_OPEN_SETTINGS                  0x0025 // Befehl für den neuen Automatikmodus
#define ALARM_SETTINGS_PRO                  0x0026 // Befehl für die neue Alarmeinstellung
#define IGNORE_AUTO_MODE                    0x0028 // Befehl von einer Apple Watch um den Automatikmodus temporär für die Verbindung zu deaktivieren

////////// STATUSCODES ////////////
#define STATUS_SUCCESS                      0x00
#define STATUS_MOTOR_1_CLOSING              0x01
#define	STATUS_MOTOR_1_CLOSED               0x02
#define STATUS_MOTOR_1_CLOSE_BLOCKED        0x03
#define STATUS_MOTOR_1_CLOSE_MOVED          0x04
#define STATUS_APP_MOVEMENT                 0x05
#define STATUS_MOTOR_1_OPENING              0x0A
#define STATUS_MOTOR_1_OPENED               0x0B
#define STATUS_MOTOR_1_OPEN_BLOCKED         0x0C
#define STATUS_MOTOR_1_LOCK_STATE_UNKNOWN   0x0F
#define STATUS_ALARM_ON                     0x10
#define STATUS_ALARM_OFF                    0x20
#define STATUS_BOND_COMPLETE                0x30
#define STATUS_CONN_COMPLETE                0x31
#define STATUS_BATT_LOW                     0x40
#define STATUS_BATT_CHANGED                 0x41
#define STATUS_MAX_BONDS                    0x50
#define STATUS_BOND_ERASED                  0x51
#define STATUS_BOND_NOT_FOUND               0x52
#define STATUS_FACTORY_RESET_COMPLETE       0x53
#define STATUS_BOND_FROM_HS                 0x60
#define STATUS_FOB_CONNECTED                0x70
#define STATUS_FOB_DISCONNECTED             0x80
#define STATUS_FOB_BONDINGMODE              0x81
#define STATUS_CHAIN_CONNECTED              0x82
#define STATUS_CHAIN_REMOVED                0x83
#define STATUS_ERR_GENERAL                  0x90
#define STATUS_ERR_NOT_ALLOWED              0x91
#define STATUS_ERR_CRC                      0x92
#define STATUS_ERR_TIMEOUT                  0x93
#define STATUS_ERR_DND_ACTIVE               0x94
#define STATUS_ERR_WRONG_MSG_SIZE           0x95
#define STATUS_ERR_WRONG_AUTH_ID            0x96
#define STATUS_ERR_AUTH_FAILED              0x97
#define STATUS_ERR_BOND_FAILED              0x98
#define STATUS_ERR_NO_AUTH                  0x99
#define STATUS_ERR_WRONG_COUNTER            0x9A
#define STATUS_ERR_ENTER_DFU_FAILED         0x9B
#define STATUS_ERR_DFU_TOO_MANY_CONNECTIONS 0x9C
#define STATUS_ERR_ACC_SELFTEST_FAILED      0x9D
#define STATUS_ERR_BONDING_ACTIVE           0x9E
#define STATUS_MOTOR_2_CLOSING              0xB1
#define	STATUS_MOTOR_2_CLOSED               0xB2
#define STATUS_MOTOR_2_CLOSE_BLOCKED        0xB3
#define STATUS_MOTOR_2_OPENING              0xBA
#define STATUS_MOTOR_2_OPENED               0xBB
#define STATUS_MOTOR_2_OPEN_BLOCKED         0xBC
#define	STATUS_MOTOR_2_LOCK_STATE_UNKNOWN   0xBF
#define STATUS_EMPTY                        0xFF

////////// Befehlsargumente ////////////
#define LOCK_ACTION_OPEN                    0x01
#define LOCK_ACTION_CLOSE                   0x02
#define LOCK_ACTION_OPEN_CHAIN              0x03
#define LOCK_ACTION_CLOSE_CHAIN             0x04
#define DEVICE_SETTINGS_FACTORY_RESET       0x02
#define DEVICE_SETTINGS_NEW_BOND            0x05
#define DEVICE_SETTINGS_QUIT_ALARM          0x0A
#define DEVICE_SETTINGS_THEFT_REQ_ON        0x0B
#define DEVICE_SETTINGS_THEFT_REQ_OFF       0x0C
#define DEVICE_SETTINGS_TEST_GPS            0x11

////////// App/Bootloader Flag ////////////
#define APPLICATION_IS_ACTIVE               0x0A
#define BOOTLOADER_IS_ACTIVE                0x0B

// Befehle f�r GSM-Kommunikation
#define GPS_RETRY_COUNT             6

#define CMD_STATUS                          0x01    // Statusmeldungen, Alarm, Ladevorgang beendet, Unfallerkennung, nicht geschlossen (Automatik), Fehler bei �ffnen/Schlie�en, etc...
#define CMD_INFO                            0x02    // FW-Version, Batteriestand, Schlie�zustand
#define CMD_THEFT_REQ                       0x03    // Diebstahlmeldung von Server an Schloss
#define CMD_SIGNAL_SOUND                    0x04    // Signalton abspielen
#define CMD_GPS_RESET                       0x05    
#define CMD_LOCKSTATE                       0x06    
#define CMD_LOCK_RESET                      0x07
#define CMD_LOCKING_REQ                     0x08
#define CMD_DEACTIVATE_ALARM                0x09
#define CMD_CAN_INFO                        0x0A
#define CMD_GET_CAN_INFO                    0x0B
#define CMD_GPS_OFF                         0x0C
#define CMD_BUTTON_OFF                      0x0D
#define CMD_BUTTON_ON                       0x0E
#define CMD_FOB_REQ                         0x10
#define CMD_FOB_RESP                        0x11
#define CMD_RFID_REQ                        0x1A
#define CMD_RFID_RESP                       0x1B
#define CMD_LOCKING_CHALLENGE               0x1C
#define CMD_LOCKING_RESP                    0x1D
#define CMD_THEFT_RESP                      0x1E
#define CMD_INFO_B2C                        0x1F

#define CMD_CONF_ALARM                      0x20
#define CMD_CONF_ALARM_MODE                 0x21
#define CMD_CONF_COLORCODE                  0x22
#define CMD_CONF_SOUND                      0x23
#define CMD_CONF_POSITION_PERIODIC          0x24
#define CMD_CONF_NOTIFICATIONS              0x26
#define CMD_CONF_NOTIFICATION_TRACKALL                  0xA0
#define CMD_CONF_NOTIFICATION_TRACKLPW                  0xA1
#define CMD_CONF_NOTIFICATION_TIMEOUTS                  0x27
#define CMD_CONF_AVAILABILITY                           0x28
#define CMD_CONF_AVAILABILITY_OPENED_BATT_LEVEL         0xA0
#define CMD_CONF_AVAILABILITY_OPENED_LPW_INTERVAL       0xA1
#define CMD_CONF_AVAILABILITY_CLOSED_BATT_LEVEL         0xA2
#define CMD_CONF_AVAILABILITY_CLOSED_LPW_INTERVAL       0xA3
#define CMD_CONF_AVAILABILITY_THEFT_BATT_LEVEL          0xA4
#define CMD_CONF_AVAILABILITY_THEFT_LPW_INTERVAL        0xA5
#define CMD_CONF_AVAILABILITY_THEFT_TRACKING_INTERVAL   0xA6
#define CMD_CONF_AVAILABILITY_TRACKING_INTERVAL         0xA7
#define CMD_CONF_EXTRAS                     0x29

#define CMD_STATUS_ALARM                    0x30
#define CMD_STATUS_LOAD_COMPLETE            0x31
#define CMD_STATUS_CLOSE_BLOCKED            0x32
#define CMD_STATUS_OPEN_BLOCKED             0x33
#define CMD_STATUS_LOCK_MOVED               0x34
#define CMD_STATUS_CRASH_DETECTION          0x35
#define CMD_STATUS_ONLINE                   0x36

#define CMD_STATUS_OPENED_CODE              0x40
#define CMD_STATUS_CLOSED_BUTTON            0x41
#define CMD_STATUS_OPENED_KEYFOB            0x42
#define CMD_STATUS_CLOSED_KEYFOB            0x43
#define CMD_STATUS_OPENED_RFID              0x44
#define CMD_STATUS_CLOSED_RFID              0x45
#define CMD_STATUS_OPENED_APP               0x46
#define CMD_STATUS_CLOSED_APP               0x47
#define CMD_STATUS_OPENED_GSM               0x48
#define CMD_STATUS_CLOSED_GSM               0x49
#define CMD_STATUS_TRACK_ALL                0x4A
#define CMD_STATUS_TRACK_LPW                0x4B
#define CMD_STATUS_OPENED_BUTTON            0x4C
#define CMD_STATUS_NOT_STOLEN               0x60

#define CMD_TESTMODE_DATA_REQ               0x50
#define CMD_TESTMODE_DATA_RESP              0x51
#define CMD_TESTMODE_RESULT                 0x52 
#define CMD_TESTMODE_SERIAL                 0x53
#define CMD_TESTMODE_SERIAL_PRO             0x54

#define CMD_ACK                             0xAC

#define CMD_ERR_WRONG_CRC                   0xE0
#define CMD_ERR_WRONG_COMMAND               0xE1
#define CMD_ERR_WRONG_LENGTH                0xE2
#define CMD_ERR_AUTH_FAILED                 0xE3
#define CMD_ERR_MCP_INIT_FAILED             0xE4
#define CMD_ERR_NOT_SUPPORTED               0xE5

#define CMD_FW_SEND_PACKET                  0xF0
#define CMD_FW_REQ_PACKET                   0xF1
#define CMD_FW_FINISHED                     0xF2
#define CMD_FW_UPDATE_SUCCESSFUL            0xF3
#define CMD_FW_UPDATE_FAILED                0xF4


#endif
```

## src/defines.h
```c
#ifndef DEFINES_H__
#define DEFINES_H__

// Firmware-Version
#define FIRMWARE_MAJOR  50
#define FIRMWARE_MINOR  55

#define CLOSE_BY_USER_AFTER_BLOCKING
#define DFU_WITHOUT_CHECK

// Memory Layout
// https://infocenter.nordicsemi.com/index.jsp?topic=%2Fsdk_nrf5_v17.1.0%2Flib_bootloader.html&anchor=lib_bootloader_memory
// https://infocenter.nordicsemi.com/index.jsp?topic=%2Fcom.nordic.infocenter.sdk5.v14.2.0%2Flib_bootloader_dfu_banks.html&cp=4_0_0_3_5_1_2_2&anchor=lib_bootloader_dfu_appdata

//Softdevice Memory Usage
// https://infocenter.nordicsemi.com/index.jsp?topic=%2Fsds_s132%2FSDS%2Fs1xx%2Fmem_usage%2Fmem_usage.html

////////////////////////////////////////////////////////////////////////
////////////////////       Speicher-Konfiguration     //////////////////
////////////////////////////////////////////////////////////////////////

// Speicher nrf54L15 gesamt     0x17D000    1560576 Byte


// Verbleibender Platz f+r App  0xb5800     135168 Byte 	(festgelegt in pm_static.yml)

// Bank 0 ab Adresse            0x8800
// Bank 1 ab Adresse            0xbe000
// App-Speicher ab Addresse     0x174000    (Größe 0x4000)
// Settings ab Adresse          0x178000    (Größe 0x2000)
// Bootloader ab Adresse        0x00

////////// RAM ////////////
// RAM nrf54L15 gesamt          0x20000     131072 Byte
// RAM Start                    0x20000000 
// RAM Retention Adresse        0x2001ff00 (Größe 0x100)


///////// Connection Interval ///////
#define CONN_INT_MIN            0x0018
#define CONN_INT_MAX            0x003C

///////// RSSI-Auswertung ///////
#define RSSI_AVG_COUNT                      10
#define RSSI_STATE_FAR                      0x00
#define RSSI_STATE_NEAR                     0x01

//////////// RSSI-Einstellungen ////////////
#define DIST_VERY_VERY_NEAR                 6
#define DIST_VERY_NEAR                      5
#define DIST_NEAR                           1
#define DIST_MEAN                           2
#define DIST_FAR                            3
#define DIST_VERY_FAR                       4

//////////// Automatisches Schließen ////////////
#define RELOCK_INACTIVE                     0x00
#define RELOCK_AUTO_OPENED                  0x01
#define RELOCK_MOVEMENT_CHECK               0x02
#define RELOCK_CLOSED                       0x03

#define RELOCK_THRESHOLD                    30

//////////// Alarmeinstellungen ////////////
#define ALARM_SENS_LOWEST                   35
#define ALARM_SENS_LOW                      30
#define ALARM_SENS_MID                      25
#define ALARM_SENS_HIGH                     20
#define ALARM_SENS_HIGHER                   15
#define ALARM_SENS_HIGHEST                  10
#define ALARM_SENS_GPS_ACTIVE               20
#define ALARM_MODE_SILENT                   0x01
#define ALARM_MODE_LOWEST                   0x02
#define ALARM_MODE_LOW                      0x04
#define ALARM_MODE_MID                      0x08
#define ALARM_MODE_HIGH                     0x10
#define ALARM_MODE_PREALARM                 0x20
#define ALARM_MODE_HIGHER                   0x40
#define ALARM_MODE_HIGHEST                  0x80


///////// Toneinstellungen ///////
#define SOUND_CONF_OFF                      0x00
#define SOUND_CONF_WARNING                  0x01
#define SOUND_CONF_OPEN                     0x02
#define SOUND_CONF_CLOSE                    0x04

////////// PWM-Frequenzen //////////
#define FREQ_ALARM_MIN                      2900
#define FREQ_ALARM_MAX                      3500
#define FREQ_PREALARM_MIN                   3500
#define FREQ_PREALARM_MAX                   3500
#define FREQ_SIGNAL_MIN                     3000
#define FREQ_SIGNAL_MAX                     4000
#define FREQ_BEEP                           3500
#define FREQ_LOW_BATT_MIN                   5000
#define FREQ_LOW_BATT_MAX                   7500

///////// BLE-Timeouts ///////
#define BLE_NONE                            0x00
#define BLE_GDIO_ACK                        0x01
#define BLE_USDIO_ACK                       0x02
#define BLE_AUTH                            0x04

///////// 4G Diebstahl-Modus //////////
#define THEFT_MODE_ACTIVE                   0x01
#define THEFT_MODE_STOLEN                   0x02

// Pin-Auswertung für Eingänge
#define IRQ_ACC_ALARM                       0x0001
#define IRQ_ACC_RELOCK                      0x0002
#define IRQ_MOTOR_1_CLOSED                  0x0004
#define IRQ_MOTOR_1_OPENED                  0x0008
#define IRQ_BUTTON                          0x0010
#define IRQ_PLUG_DETECTION                  0x0020
#define IRQ_CHARGE_COMPLETED                0x0040
#define IRQ_MOTOR_2_CLOSED                  0x0080
#define IRQ_MOTOR_2_OPENED                  0x0100
#define IRQ_CHARGE_STARTED                  0x0200


#define MAIN_BUTTON_PULL                    NRF_GPIO_PIN_PULLDOWN

// Startwert bei Farbcode-Eingabe
#define SELECTED_COLOR_INIT_VAL             3

// Zustand der Service-Code Eingabe
#define SERVICE_CODE_INACTIVE               0
#define SERVICE_CODE_ALLOWED                1
#define SERVICE_CODE_CORRECT                2

///////// LED-Blinkmodi ///////
#define LED_FLASH_ERROR                     0x01
#define LED_FLASH_DISCONNECT                0x02
#define LED_FLASH_BONDING                   0x03

///////// LED-Farben ///////
#define LED_OFF 0x00
#define LED_R   0x01
#define LED_G   0x02
#define LED_B   0x04
#define LED_W   0x07

///////// LED-PWM ///////
#define LED_PWM_SEQ_VALUE                   80

///////// Doppelklick-Zeit ///////
#define DOUBLE_CLICK_TIMEOUT                1000

///////// Flash ///////
#define SETTINGS_ID         0x1111
#define SETTINGS_KEY        0x2222

#define PEER_DATA_ID        0x1112  // WICHTIG: Wenn die ID oder der KEY ge�ndert wird, muss dies auch im Bootloader ge�ndert werden
#define PEER_DATA_KEY       0x2223  // da sonst die Bonding-Daten nicht mehr ausgelesen werden k�nnen

// Flash Blocks für den Testmodus
#define TESTMODE_ID         0x3330
#define TESTMODE_KEY        0x4441

//////////// Verbindungsparameter ////////////
#define APP_BLE_CONN_CFG_TAG            1                                           /**< A tag identifying the SoftDevice BLE configuration. */
#define APP_BLE_OBSERVER_PRIO           3                                           /**< Application's BLE observer priority. You shouldn't need to modify this value. */
// TEST (Stromprofil-Diagnose): Intervall auf 1,28 s gesetzt, um zu pruefen,
// ob die gemessenen Stromspitzen dem Advertiser folgen.
// ORIGINAL: MIN = 510 (319 ms), MAX = 700 (438 ms)
#define APP_ADV_INTERVAL_MIN            2048                                        /**< 2048 * 0,625 ms = 1280 ms */
#define APP_ADV_INTERVAL_MAX            2048                                        /**< 2048 * 0,625 ms = 1280 ms */
#define APP_ADV_DURATION                BLE_GAP_ADV_TIMEOUT_GENERAL_UNLIMITED       /**< Unlimited advertising in general discoverable mode */
#define MIN_CONN_INTERVAL               MSEC_TO_UNITS(20, UNIT_1_25_MS)             /**< Minimum acceptable connection interval (20 ms), Connection interval uses 1.25 ms units. */
#define MAX_CONN_INTERVAL               MSEC_TO_UNITS(75, UNIT_1_25_MS)             /**< Maximum acceptable connection interval (75 ms), Connection interval uses 1.25 ms units. */
#define SLAVE_LATENCY                   0                                           /**< Slave latency. */
#define CONN_SUP_TIMEOUT                MSEC_TO_UNITS(4000, UNIT_10_MS)             /**< Connection supervisory timeout (4 seconds), Supervision Timeout uses 10 ms units. */
#define FIRST_CONN_PARAMS_UPDATE_DELAY  K_MSEC(5000)                       /**< Time from initiating event (connect or start of notification) to first time sd_ble_gap_conn_param_update is called (5 seconds). */
#define NEXT_CONN_PARAMS_UPDATE_DELAY   K_MSEC(30000)                      /**< Time between each call to sd_ble_gap_conn_param_update after the first call (30 seconds). */
#define MAX_CONN_PARAMS_UPDATE_COUNT    3                                           /**< Number of attempts before giving up the connection parameter negotiation. */

#define SEC_PARAM_BOND                      1                                       /**< Perform bonding. */
#define SEC_PARAM_MITM                      0                                       /**< Man In The Middle protection not required. */
#define SEC_PARAM_LESC                      0                                       /**< LE Secure Connections enabled. */
#define SEC_PARAM_KEYPRESS                  0                                       /**< Keypress notifications not enabled. */
#define SEC_PARAM_IO_CAPABILITIES           BLE_GAP_IO_CAPS_NONE                    /**< No I/O capabilities. */
#define SEC_PARAM_OOB                       0                                       /**< Out Of Band data not available. */
#define SEC_PARAM_MIN_KEY_SIZE              7                                       /**< Minimum encryption key size. */
#define SEC_PARAM_MAX_KEY_SIZE              16                                      /**< Maximum encryption key size. */

#define SCAN_INTERVAL                       0x12C0
#define SCAN_WINDOW                         0x0050
#define SCAN_INTERVAL_BONDING               0x00C0
#define SCAN_WINDOW_BONDING                 0x00A0

#define MAX_FOB_BONDS                       3

//////////// UART-Konfiguration ////////////
#define GSM_TX_BUFF_SIZE 128
#define GSM_RX_BUFF_SIZE 64
#define RECEIVE_TIMEOUT 10000                                                           /**< Inaktivitäts-Timeout des Empfangs in µs, danach meldet der Treiber den Puffer per UART_RX_RDY. Muss deutlich > 1 Zeichendauer sein (9600 Baud -> 1,04 ms). */
#define UART_RX_LINE_SIZE 128                                                           /**< Maximale Länge einer zusammengesetzten Empfangsnachricht (ohne Zeilenende). */
#define UART_TX_TIMEOUT_US 100000                                                       /**< Timeout für einen Sendevorgang in µs (100 ms). */

//////////// Error-Tag ////////////
#define DEAD_BEEF                       0xDEADBEEF                                  /**< Value used as error code on stack dump, can be used to identify stack location on stack unwind. */

//////////// Timer-Intervalle ////////////
#define SINGLE_SHOT_TIMEOUT                     K_MSEC(0)           // Makro für einen einmaligen Aufruf eines Timers 
#define BUTTON_DETECTION_INTERVAL               K_MSEC(50)          // Pause von einem GPIOTE event bis ein Taster als gedrückt erkannt wird
#define IND_ACK_TIMEOUT_INTERVAL                K_MSEC(2000)	    // Timeout für Indication Acknowledgement
#define BOND_LED_TIMEOUT_INTERVAL               K_MSEC(300)         // Intervall für das blaue Blinken beim Bonding
#define FDS_STORAGE_TIMEOUT_INTERVAL            K_MSEC(400)         // Intervall zum überprüfen der FDS-Aktivität
#define MOTOR_TIMEOUT_INTERVAL                	K_MSEC(15000) 	    // Motor abschalten
#define MC3630_TIMEOUT_INTERVAL                 K_MSEC(100)         // Intervall zum Auswerten der Bewegung
#define PREALARM_TIMEOUT_INTERVAL               K_MSEC(3500)        // Intervall bis zum Beenden des Voralarms
#define WATCHDOG_TIMEOUT_INTERVAL               K_MSEC(3000)        // Intervall fürs Nachladen des Watchdog Registers
#define BUTTONPRESS_TIMEOUT_INTERVAL            K_MSEC(50)          // Intervall für das Zählen der Klickdauer
#define BOND_TIMEOUT_INTERVAL                   K_MSEC(90000)       // Intervall für Bonding
#define PLUG_DETECTION_TIMEOUT_INTERVAL         K_MSEC(3000)        // Intervall zum Abschließen per Kettenerkennung
#define GSM_SEND_TIMEOUT_INTERVAL               K_MSEC(20000)       // Intervall zum Versenden eines GSM-Befehls
#define ACC_TEST_TIMEOUT_INTERVAL               K_MSEC(2000)        // Intervall bis zum Selbsttest des Beschleunigungssensors
#define CHECK_ALARM_TIMEOUT                     K_MSEC(4000)        // Intervall für Alarmprüfung
#define BEEP_TIMEOUT_INTERVAL                   K_MSEC(500)         // Intervall zum Beenden eines Pieptons
#define WARN_TIMEOUT_INTERVAL                   K_MSEC(200)         // Intervall zum Wiederholen des Warntons
#define PLUG_REACTIVATION_TIMEOUT_MS            2000                // Intervall zum Reaktivieren des Kettentasters nach Abzug der Kette
#define CHECK_AUTO_CLOSE_TIMEOUT                K_MSEC(30000)       // Intervall für die Bewegungsüberprüfung nach autom. Öffnen
#define RESET_WRONG_COLORCODE_TIMEOUT_INTERVAL  K_MSEC(180000)      // Intervall zum Prüfen der falschen Eingaben des Farbcodes
#define HALLSENSOR_TIMEOUT_INTERVAL             K_MSEC(3000)        // Timeout bis Hallsensor Interrupt aktiviert wird
#define ONE_SEC_TIMEOUT_INTERVAL                K_MSEC(1000)        // 1 Sek. Timeout
#define TWO_SEC_TIMEOUT_INTERVAL                K_MSEC(2000)        // 2 Sek. Timeout
#define THREE_SEC_TIMEOUT_INTERVAL              K_MSEC(3000)        // 3 Sek. Timeout
#define FIVE_SEC_TIMEOUT_INTERVAL               K_MSEC(5000)        // 5 Sek. Timeout
#define TEN_SEC_TIMEOUT_INTERVAL                K_MSEC(10000)       // 10 Sek. Timeout
#define TWENTY_SEC_TIMEOUT_INTERVAL             K_MSEC(20000)       // 20 Sek. Timeout
#define THIRTY_SEC_TIMEOUT_INTERVAL             K_MSEC(30000)       // 30 Sek. Timeout
#define ONE_MIN_TIMEOUT_INTERVAL                K_MSEC(60000)       // 60 Sek. Timeout
#define THREE_MIN_TIMEOUT_INTERVAL              K_MSEC(180000)      // 180 Sek. Timeout
#define SIX_MIN_TIMEOUT_INTERVAL                K_MSEC(360000)      // 6 Minuten Timeout zum Messen einer Zeitspanne
#define DOUBLE_TAP_TIMEOUT_INTERVAL             K_MSEC(500)         // Timeout zum Anzeigen des erkannten Doppeltaps


///////// Testmodi ///////
#define TEST_NONE                           0x00
#define TEST_MECHANIC                       0x0100
#define TEST_GSM                            0x0200
#define TEST_LEDS                           0x0400
#define TEST_NOT_FOUND                      0x8000

///////// RAM-Offsets für Variablen ///////
#define RAM_LOCKSTATE_OFFSET                0
#define RAM_BLVERSION_OFFSET                10

///////// Stackgröße für RSSI-Thread ///////
#define RSSI_STACKSIZE 512

///////// Stackgröße für LED-Thread ///////
#define LED_STACKSIZE 512

///////// Watchdog Konfiguration ///////
#define WDT_MAX_WINDOW  5000U
#define WDT_MIN_WINDOW  0U
#define WDT_OPT WDT_OPT_PAUSE_IN_SLEEP// WDT_OPT_PAUSE_HALTED_BY_DBG gibt es auch noch

///////// Find-My Advertising-Konfiguration ///////
#define ILI_PRO_BT_ID   BT_ID_DEFAULT
#define FMNA_BT_ID      1

#endif // #ifndef DEFINES_H__
```

## src/power_debug.c
```c
#include "power_debug.h"

#if POWER_DEBUG_ENABLED

#include <zephyr/kernel.h>
#include <zephyr/devicetree.h>
#include <zephyr/logging/log.h>

#include <soc.h>
#include <nrfx.h>
#include <hal/nrf_gpio.h>
#include <hal/nrf_timer.h>

#if defined(NRF_CRACEN)
#include <hal/nrf_cracen.h>
#endif

LOG_MODULE_REGISTER(power_debug, LOG_LEVEL_INF);

#define ZEPHYR_USER_NODE DT_PATH(zephyr_user)

/* ------------------------------------------------------------------ */
/* Peripherie                                                          */
/* ------------------------------------------------------------------ */

/**@brief Ein ENABLE-Register mit Klartext-Bewertung ausgeben.
 *
 * Bei allen betroffenen Bloecken bedeutet 0 "abgeschaltet". Ein Wert != 0
 * im Ruhezustand ist genau das, wonach wir suchen.
 */
static void enable_reg_log(const char *name, uint32_t value)
{
    LOG_INF("  %-10s ENABLE = 0x%08X  %s", name, value, value ? "<== AKTIV" : "aus");
}

/**@brief Prueft, ob ein TIMER laeuft, indem der Zaehler zweimal gelesen wird.
 *
 * Ein TIMER hat kein ENABLE-Register. Steht der Zaehler, ist der Timer
 * gestoppt; laeuft er, haelt er den Peripherie-Takt und kostet Strom.
 */
static void timer_running_log(const char *name, NRF_TIMER_Type *p_reg)
{
    uint32_t first;
    uint32_t second;

    nrf_timer_task_trigger(p_reg, NRF_TIMER_TASK_CAPTURE5);
    first = nrf_timer_cc_get(p_reg, NRF_TIMER_CC_CHANNEL5);

    k_busy_wait(200);

    nrf_timer_task_trigger(p_reg, NRF_TIMER_TASK_CAPTURE5);
    second = nrf_timer_cc_get(p_reg, NRF_TIMER_CC_CHANNEL5);

    LOG_INF("  %-10s CC5 %u -> %u  %s", name, first, second,
            (first != second) ? "<== LAEUFT" : "gestoppt");
}

static void dump_peripherals(void)
{
    LOG_INF("--- Peripherie ---");

#if defined(NRF_CRACEN)
    /* Bits: 0 = CRYPTOMASTER, 1 = RNG, 2 = PKE/IKG. Im Leerlauf muss das 0
     * sein - cracen_release() schaltet den Block ab. Bleibt hier etwas
     * stehen, haengt ein PSA-Vorgang (Hash/Cipher/RNG) unbeendet fest. */
    enable_reg_log("CRACEN", nrf_cracen_module_get(NRF_CRACEN));
#endif

#if defined(NRF_SPIM00)
    enable_reg_log("SPIM00", NRF_SPIM00->ENABLE);
#endif
#if defined(NRF_TWIM20)
    enable_reg_log("TWIM20", NRF_TWIM20->ENABLE);
#endif
#if defined(NRF_SAADC)
    enable_reg_log("SAADC", NRF_SAADC->ENABLE);
#endif
#if defined(NRF_PWM20)
    enable_reg_log("PWM20", NRF_PWM20->ENABLE);
#endif
#if defined(NRF_PWM21)
    enable_reg_log("PWM21", NRF_PWM21->ENABLE);
#endif
#if defined(NRF_PWM22)
    enable_reg_log("PWM22", NRF_PWM22->ENABLE);
#endif

    timer_running_log("TIMER20", NRF_TIMER20);
    timer_running_log("TIMER22", NRF_TIMER22);
}

/* ------------------------------------------------------------------ */
/* GPIO                                                                */
/* ------------------------------------------------------------------ */

struct pin_entry {
    const char *name;
    uint32_t    psel;   /* absolute Pin-Nummer: Port * 32 + Pin */
};

#define PIN_USER(prop)  { #prop, NRF_DT_GPIOS_TO_PSEL(ZEPHYR_USER_NODE, prop) }
#define PIN_NODE(label, node, prop) { label, NRF_DT_GPIOS_TO_PSEL(node, prop) }

static const struct pin_entry m_pins[] = {
    PIN_USER(charge_gpios),
    PIN_USER(accel_int1_gpios),
    PIN_USER(nled_r_gpios),
    PIN_USER(nled_g_gpios),
    PIN_USER(nled_b_gpios),
    PIN_USER(piezo_freq_gpios),
    PIN_USER(piezo_en_gpios),
    PIN_USER(piezo_en2_gpios),
    PIN_USER(motor_open_gpios),
    PIN_USER(motor_close_gpios),
    PIN_USER(motor_2_open_gpios),
    PIN_USER(motor_2_close_gpios),
    PIN_USER(n_detect_mot_a_gpios),
    PIN_USER(n_detect_mot_b_gpios),
    PIN_USER(motor_sleep_gpios),
    PIN_USER(hall_open_gpios),
    PIN_USER(hall_close_gpios),
    PIN_USER(gps_enable_gpios),
    PIN_USER(fe_enable_gpios),
    PIN_USER(plug_detection_gpios),
    PIN_NODE("main_button", DT_ALIAS(sw0), gpios),
#if DT_NODE_HAS_STATUS_OKAY(DT_NODELABEL(can_controller))
    PIN_NODE("can_int", DT_NODELABEL(can_controller), int_gpios),
#endif
#if DT_NODE_HAS_STATUS_OKAY(DT_NODELABEL(spi00))
    PIN_NODE("can_cs", DT_NODELABEL(spi00), cs_gpios),
#endif
};

static void dump_pins(void)
{
    LOG_INF("--- GPIO (P<port>.<pin>) ---");

    for (uint8_t i = 0; i < ARRAY_SIZE(m_pins); i++)
    {
        uint32_t psel = m_pins[i].psel;

        nrf_gpio_pin_dir_t   dir   = nrf_gpio_pin_dir_get(psel);
        nrf_gpio_pin_input_t input = nrf_gpio_pin_input_get(psel);
        nrf_gpio_pin_pull_t  pull  = nrf_gpio_pin_pull_get(psel);

        const char *dir_str = (dir == NRF_GPIO_PIN_DIR_OUTPUT) ? "OUT" : "in ";
        const char *pull_str = (pull == NRF_GPIO_PIN_PULLUP)   ? "PU"
                             : (pull == NRF_GPIO_PIN_PULLDOWN) ? "PD"
                                                               : "--";

        if (dir == NRF_GPIO_PIN_DIR_OUTPUT)
        {
            LOG_INF("  P%u.%02u %-22s %s  out=%u", psel / 32, psel % 32,
                    m_pins[i].name, dir_str, nrf_gpio_pin_out_read(psel));
        }
        else if (input == NRF_GPIO_PIN_INPUT_DISCONNECT)
        {
            /* Eingangspuffer getrennt - der sichere Ruhezustand. */
            LOG_INF("  P%u.%02u %-22s abgeklemmt", psel / 32, psel % 32,
                    m_pins[i].name);
        }
        else
        {
            /* Verbundener Eingang OHNE Pull ist der Verdachtsfall: liegt der
             * Pegel extern nicht fest, zieht der Eingangspuffer dauerhaft
             * Querstrom. */
            LOG_INF("  P%u.%02u %-22s %s  pull=%s  level=%u  %s",
                    psel / 32, psel % 32, m_pins[i].name, dir_str, pull_str,
                    nrf_gpio_pin_read(psel),
                    (pull == NRF_GPIO_PIN_NOPULL) ? "<== Eingang ohne Pull" : "");
        }
    }
}

/* ------------------------------------------------------------------ */
/* API                                                                 */
/* ------------------------------------------------------------------ */

void power_debug_dump(void)
{
    LOG_INF("===== power_debug =====");
    dump_peripherals();
    dump_pins();
    LOG_INF("=======================");
}

void power_debug_tick(void)
{
    static int64_t next_dump;

    int64_t now = k_uptime_get();

    if (now < next_dump)
    {
        return;
    }

    next_dump = now + POWER_DEBUG_PERIOD_MS;
    power_debug_dump();
}

#endif /* POWER_DEBUG_ENABLED */
```

## src/power_debug.h
```c
/**
 * @file power_debug.h
 * @brief Diagnose fuer die Suche nach Ruhestrom-Verursachern.
 *
 * Liest im Leerlauf die ENABLE-Register der Peripherie und die Pin-
 * Konfiguration aller genutzten GPIOs aus und gibt sie ueber das Log aus.
 * Damit laesst sich ohne Raten feststellen, welcher Block im Ruhezustand
 * noch aktiv ist bzw. welcher Pin offen (floating) am Eingangspuffer haengt.
 *
 * Nur ein Diagnose-Werkzeug - vor dem Serienstand wieder entfernen bzw.
 * POWER_DEBUG_ENABLED auf 0 setzen.
 */

#ifndef POWER_DEBUG_H__
#define POWER_DEBUG_H__

#include <stdint.h>

/* Auf 0 setzen, um die komplette Diagnose aus dem Build zu nehmen. */
#define POWER_DEBUG_ENABLED     1

/* Abstand zwischen zwei zyklischen Ausgaben in Millisekunden. */
#define POWER_DEBUG_PERIOD_MS   10000

/* Ruhestrom-Test: Auf 1 setzen, dann parkt main() sofort in einer Schlaf-
 * schleife - keine App-Initialisierung, kein Bluetooth, kein Watchdog.
 * Es laufen nur die Zephyr-Treiber-Inits, die vor main() ausgefuehrt werden.
 *
 * Damit laesst sich der Grundstrom von SoC und Platine vom Beitrag der
 * Anwendung trennen. Zusaetzlich sollte fuer diesen Test can_controller im
 * Board-DTS auf "disabled" stehen, sonst laesst der Zephyr-CAN-Treiber den
 * MCP2518FD nach seinem Init wach zurueck (ili_can_init() laeuft ja nicht).
 *
 * ACHTUNG: Mit diesem Schalter tut das Geraet nichts mehr - reiner Messstand. */
#define POWER_DEBUG_IDLE_ONLY   0

#if POWER_DEBUG_ENABLED

/**@brief Gibt den aktuellen Zustand von Peripherie und Pins einmalig aus. */
void power_debug_dump(void);

/**@brief Aus der Hauptschleife aufrufen - gibt hoechstens alle
 *        POWER_DEBUG_PERIOD_MS Millisekunden aus. */
void power_debug_tick(void);

#else

static inline void power_debug_dump(void) {}
static inline void power_debug_tick(void) {}

#endif /* POWER_DEBUG_ENABLED */

#endif /* POWER_DEBUG_H__ */
```
